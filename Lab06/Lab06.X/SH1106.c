/******************************************************************************
* @file    sh1106.c
* @author Driver obtained from the OLED manufacturer (Waveshare Team)
* @Adapted for PIC32 by  Erick Moreno and Girma Tewolde
* @Last Modified: 11/11/2019 @ 10:30 PM
* @brief   This file includes the OLED driver for SH1106 display module
******************************************************************************
*/

#include <stdio.h>
#include "SH1106.h"

#define CPU_FREQ    80000000
#define ONE_SEC_TICKS (CPU_FREQ/2)

//SPI config
#define SPI_CONFIG 0x8070
#define SPI_BAUD   99 //To set the SPI clock freq to 200kHz... module can't go past 400kHz

const uint8_t Font1206[95][12] = {
    {0x00,0x00,0x00,0x00,0x00,0x00,0x00,0x00,0x00,0x00,0x00,0x00},/*" ",0*/
    {0x00,0x00,0x00,0x00,0x3F,0x40,0x00,0x00,0x00,0x00,0x00,0x00},/*"!",1*/
    {0x00,0x00,0x30,0x00,0x40,0x00,0x30,0x00,0x40,0x00,0x00,0x00},/*""",2*/
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    {0x40,0x00,0x80,0x00,0x40,0x00,0x20,0x00,0x20,0x00,0x40,0x00},/*"~",94*/
}; 

const uint8_t Font1612[11][32] = 
{
    {0x00,0x00,0x3F,0xFC,0x3F,0xFC,0x30,0x0C,0x30,0x0C,0x30,0x0C,0x30,0x0C,0x30,0x0C,
    0x30,0x0C,0x30,0x0C,0x30,0x0C,0x30,0x0C,0x30,0x0C,0x3F,0xFC,0x3F,0xFC,0x00,0x00},/*"0",0*/
    {0x00,0x00,0x00,0x00,0x00,0x00,0x00,0x00,0x00,0x00,0x00,0x00,0x00,0x00,0x30,0x00,
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    0x18,0x30,0x00,0x00,0x00,0x00,0x00,0x00,0x00,0x00,0x00,0x00,0x00,0x00,0x00,0x00},/*":",10*/
};

const uint8_t Font1608[95][16] = {      
    {0x00,0x00,0x00,0x00,0x00,0x00,0x00,0x00,0x00,0x00,0x00,0x00,0x00,0x00,0x00,0x00},/*" ",0*/
    {0x00,0x00,0x00,0x00,0x00,0x00,0x1F,0xCC,0x00,0x0C,0x00,0x00,0x00,0x00,0x00,0x00},/*"!",1*/
    {0x00,0x00,0x08,0x00,0x30,0x00,0x60,0x00,0x08,0x00,0x30,0x00,0x60,0x00,0x00,0x00},/*""",2*/
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    {0x00,0x00,0x60,0x00,0x80,0x00,0x80,0x00,0x40,0x00,0x40,0x00,0x20,0x00,0x20,0x00},/*"~",94*/
};

const uint8_t Font3216[11][64] = 
{
    {0x00,0x00,0x00,0x00,0x00,0x00,0x00,0x00,0x3F,0xFF,0xFF,0xFC,0x3F,0xFF,0xFF,0xFC,    /*"0",0*/
    0x30,0x00,0x00,0x0C,0x30,0x00,0x00,0x0C,0x30,0x00,0x00,0x0C,0x30,0x00,0x00,0x0C,
    0x30,0x00,0x00,0x0C,0x30,0x00,0x00,0x0C,0x30,0x00,0x00,0x0C,0x30,0x00,0x00,0x0C,
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    0x00,0x00,0x00,0x00,0x00,0x00,0x00,0x00,0x00,0x00,0x00,0x00,0x00,0x00,0x00,0x00}
};    


void command(uint8_t cmd){
    OLED_DC = 0;
    writeSPI2Buff(&cmd, 1);
}

void writeSPI2Buff(uint8_t *buffer, uint16_t bufferLength) {    
    int i;
    for (i = 0; i < bufferLength; i++) {
        writeSPI2(buffer[i]);
    }
}

//initialize SPI2
void initSPI2(void) {
    SPI_MOSI_DIR = 0;       //config as output
    SPI_SCK_DIR = 0;        //output
    OLED_DC_DIR = 0;        //output
    OLED_RST_DIR = 0;       //output
    OLED_CS_DIR = 0;        //output
    OLED_CS = 1;            //initially disable OLED_CS (active low)
    SPI2CON = SPI_CONFIG;   //configure SPI2CON
    SPI2BRG = SPI_BAUD;     //set baud rate 
}

void SH1106_begin()
{
    OLED_CS = 0;
    OLED_RST = 1;
    //qDelay();
    usDelay(10);
    OLED_RST = 0;
    //qDelay();
    usDelay(10);
    OLED_RST = 1;
    
    command(0xAE);//--turn off oled panel
    command(0x02);//---set low column address
    command(0x10);//---set high column address
    command(0x40);//--set start line address  Set Mapping RAM Display Start Line (0x00~0x3F)
    command(0x81);//--set contrast control register
    command(0xA0);//--Set SEG/Column Mapping     
    command(0xC0);//Set COM/Row Scan Direction   
    command(0xA6);//--set normal display
    command(0xA8);//--set multiplex ratio(1 to 64)
    command(0x3F);//--1/64 duty
    command(0xD3);//-set display offset    Shift Mapping RAM Counter (0x00~0x3F)
    command(0x00);//-not offset
    command(0xd5);//--set display clock divide ratio/oscillator frequency
    command(0x80);//--set divide ratio, Set Clock as 100 Frames/Sec
    command(0xD9);//--set pre-charge period
    command(0xF1);//Set Pre-Charge as 15 Clocks & Discharge as 1 Clock
    command(0xDA);//--set com pins hardware configuration
    command(0x12);
    command(0xDB);//--set vcomh
    command(0x40);//Set VCOM Deselect Level
    command(0x20);//-Set Page Addressing Mode (0x00/0x01/0x02)
    command(0x02);//
    command(0xA4);// Disable Entire Display On (0xa4/0xa5)
    command(0xA6);// Disable Inverse Display On (0xa6/a7) 
    command(0xAF);//--turn on oled panel
}

void SH1106_clear(uint8_t* buffer)
{
    int i;
    for(i = 0;i < WIDTH * HEIGHT / 8;i++)
    {
        buffer[i] = 0;
    }
}

void SH1106_pixel(uint16_t x, uint16_t y, uint8_t color, uint8_t* buffer)
{
    if(x > WIDTH || y > HEIGHT)return ;
    if(color)
        buffer[x+(y/8)*WIDTH] |= 1<<(y%8);
    else
        buffer[x+(y/8)*WIDTH] &= ~(1<<(y%8));
}

void SH1106_char1616(uint8_t x, uint8_t y, uint8_t chChar, uint8_t* buffer)
{
    uint8_t i, j;
    uint8_t chTemp = 0, y0 = y, chMode = 0;

    for (i = 0; i < 32; i ++) {
        chTemp = *(unsigned char *)(&Font1612[chChar - 0x30][i]);
        for (j = 0; j < 8; j ++) {
            chMode = chTemp & 0x80? 1 : 0; 
            SH1106_pixel(x, y, chMode, buffer);
            chTemp <<= 1;
            y ++;
            if ((y - y0) == 16) {
                y = y0;
                x ++;
                break;
            }
        }
    }
}

void SH1106_char(uint8_t x, uint8_t y, uint8_t acsii, uint8_t size, uint8_t mode, uint8_t* buffer)
{
    uint8_t i, j, y0=y;
    char temp;
    uint8_t ch = acsii - ' ';
    for(i = 0;i<size;i++) {
        if(size == 12)
        {
            if(mode)temp = *(unsigned char *)(&Font1206[ch][i]);
            else temp = ~*(unsigned char *)(&Font1206[ch][i]);
        }
        else 
        {            
            if(mode)temp = *(unsigned char *)(&Font1608[ch][i]);
            else temp = ~*(unsigned char *)(&Font1608[ch][i]);
        }
        for(j =0;j<8;j++)
        {
            if(temp & 0x80){
                SH1106_pixel(x, y, 1, buffer);
            }
            else {
                SH1106_pixel(x, y, 0, buffer);
            }
            temp <<= 1;
            y++;
            if((y-y0) == size)
            {
                y = y0;
                x++;
                break;
            }
        }
    }
}

void SH1106_string(uint8_t x, uint8_t y, const uint8_t *pString, uint8_t Size, uint8_t Mode, uint8_t* buffer)
{
     while (*pString != '\0') {       
        if (x > (WIDTH - Size / 2)) {
            x = 0;
            y += Size;
            if (y > (HEIGHT - Size)) {
                y = x = 0;
            }
        }
        
        SH1106_char(x, y, *pString, Size, Mode, buffer);
        x += Size / 2;
        pString++;
    }
}

void SH1106_char3216(uint8_t x, uint8_t y, uint8_t chChar, uint8_t* buffer)
{
    uint8_t i, j;
    uint8_t chTemp = 0, y0 = y, chMode = 0;

    for (i = 0; i < 64; i++) {
        chTemp = *(unsigned char *)(&Font3216[chChar - 0x30][i]);
        for (j = 0; j < 8; j++) {
            chMode = chTemp & 0x80? 1 : 0; 
            SH1106_pixel(x, y, chMode, buffer);
            chTemp <<= 1;
            y++;
            if ((y - y0) == 32) {
                y = y0;
                x++;
                break;
            }
        }
    }
}

void SH1106_bitmap(uint8_t x, uint8_t y, const uint8_t *pBmp, uint8_t chWidth, uint8_t chHeight, uint8_t* buffer)
{
    uint8_t i,j,byteWidth = (chWidth + 7)/8;
    for(j = 0;j < chHeight;j++){
        for(i = 0;i <chWidth;i ++){
            if(*(unsigned char *)(pBmp +j*byteWidth+i/8) & (128 >> (i & 7))){
                SH1106_pixel(x+i,y+j,1,buffer);
            }
        }
    }       
}

void SH1106_display(uint8_t* buffer)
{
    uint8_t page;
    uint8_t *pBuf = buffer;
    
    for (page = 0; page < 8; page++) {  
        /* set page address */
        command(0xB0 + page);
        /* set low column address */
        command(0x02); 
        /* set high column address */
        command(0x10); 
        /* write data */
        OLED_DC = 1;
        writeSPI2Buff(pBuf, WIDTH); 
        pBuf += WIDTH;
    }
}

int writeSPI2(uint16_t data){
    //disable EEPROM's CS so it does not interfere with OLED communication 
    //TRISDbits.TRISD10 = 0;  //configure EEPROM CS as output
    //PORTDbits.RD10 = 1;     //set pin high so EEPROM is not selected
    OLED_CS = 0;
    SPI2BUF = data;
    while(!SPI2STATbits.SPIRBF);
    OLED_CS = 1;
    return SPI2BUF;
}  

//void qDelay(void) {
//    unsigned long count;
//    count = 300000;
//    while (count-- != 0) {
//       Nop();
//    }
//}

void usDelay(uint32_t us) {
    // Convert us microseconds into how many clock ticks it will take
    uint32_t ticks = us * (ONE_SEC_TICKS/1000000);
//    ms *= TIMER_FREQ / 1000000 ; // Core Timer updates every 2 ticks

    _CP0_SET_COUNT(0); // Set Core Timer count to 0

    // Wait until Core Timer count reaches the ticks count
    while (ticks > _CP0_GET_COUNT()); 
}